## uboot/ga36_defconfig
```kconfig
CONFIG_ARM=y
CONFIG_ARCH_SUNXI=y
CONFIG_DEFAULT_DEVICE_TREE="sun8i-a33-olinuxino"
CONFIG_DRAM_CLK=552
CONFIG_SPL=y
CONFIG_MACH_SUN8I_A33=y
CONFIG_DRAM_ZQ=15291
CONFIG_DRAM_ODT_EN=y
CONFIG_AXP_GPIO=y
# CONFIG_VIDEO_SUNXI is not set
# CONFIG_SYS_MALLOC_CLEAR_ON_INIT is not set
CONFIG_ENV_IS_NOWHERE=y
# CONFIG_ENV_IS_IN_FAT is not set
CONFIG_AXP_DCDC1_VOLT=3000
CONFIG_AXP_DLDO3_VOLT=3000
# CONFIG_USB_MUSB_HOST is not set
CONFIG_USB_MUSB_GADGET=y
CONFIG_USB_GADGET=y
CONFIG_USB_GADGET_DOWNLOAD=y
CONFIG_USB_FUNCTION_ACM=y
# CONFIG_USB_ETHER is not set
CONFIG_CONSOLE_MUX=y
CONFIG_USE_PREBOOT=y
CONFIG_PREBOOT="setenv initrd_high 0xffffffff; if test -n \"${fel_booted}\" && test -z \"${fel_scriptaddr}\"; then setenv bootdelay -1; setenv stdin serial,usbacm; setenv stdout serial,usbacm; setenv stderr serial,usbacm; fi"
```
